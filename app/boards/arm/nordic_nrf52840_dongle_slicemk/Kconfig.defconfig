## app/boards/arm/nordic_nrf52840_dongle_slicemk/Kconfig.defconfig
```kconfig
if BOARD_NORDIC_NRF52840_DONGLE_SLICEMK

config BOARD
	default "nordic_nrf52840_dongle_slicemk"

if USB

config USB_NRFX
	default y

config USB_DEVICE_STACK
	default y

endif # USB

config BT_CTLR
	default BT

endif # BOARD_NORDIC_NRF52840_DONGLE_SLICEMK
```

## app/dts/bindings/zmk,underglow-indicators.yaml
```yaml
# Copyright (c) 2020, The ZMK Contributors
# SPDX-License-Identifier: MIT

description: Underglow indicators

compatible: "zmk,underglow-indicators"

# GLOVE80_DONGLE: Optional indicator for most properties and add new dongle-central USB output state.
properties:
  bat-local:
    type: array
    required: false
    description: >
      LED indices indicating local device battery level.
      Each peripheral displays only its own battery level (not cross-peripheral battery).
      This design decision prioritizes battery efficiency: fetching a remote peripheral's battery
      level would require active BLE queries, conflicting with the battery-efficiency-first model.
      Each Glove80 half has its own underglow LEDs and independently displays its own battery status.
      Preferred name for new configurations (replaces deprecated 'bat-lhs').
  bat-detail:
    type: array
    required: false
    description: >
      LED indices indicating the fine precision within the current 20% band.
      It displays the exact position within the currently active 20% battery band (e.g. 0-19%, 20-39%, etc.) to provide more granular battery level indication.
      Only LEDs 0-4 are used for precision indication, as LED 5 is reserved for special states (100% or charging).
      Each of the 5 LEDs represents a 4% increment within the current 20% band, allowing for a more detailed battery level display.
      The display  uses progressive fill semantics (off = +0, red = +1, yellow = +2, green = +3). Completed blacks remain green while the next LED fills.
      So the offset within the 20% band is indicated by the color of the LEDs.
      For example, 0% - all LEDs are off, +1% LED 0 is red, +2% LED 0 is yellow, +3% LED 0 is green, +4% LED 0 is green + LED1 is red,
      +17% LEDs 0-3 are green + LED 4 is red, +18% LEDs 0-3 are green + LED 4 is yellow, +19% LEDs 0-4 are green.
  bat-left:
    type: array
    required: false
    description: >
      LED indices indicating left peripheral battery level (Glove80-specific topology).
      Only displayed on Glove80 central (dongle); not used on left peripheral itself.
  bat-right:
    type: array
    required: false
    description: >
      LED indices indicating right peripheral battery level (Glove80-specific topology).
      Only displayed on Glove80 central (dongle); not used on right peripheral itself.
  bat-lhs:
    type: array
    required: false
    deprecated: true
    description: >
      Deprecated: Use 'bat-local' instead.
      Legacy property from left-central era. Renamed for clarity in dongle-central topology.
      Maintained for backwards compatibility; new boards should use 'bat-local'.
  bat-rhs:
    type: array
    required: false
    deprecated: true
    description: >
      Deprecated: Removed in dongle-central topology.
      Remote peripheral battery levels are not displayed to avoid BLE fetch overhead.
      Each half displays only its own battery level on its own LEDs.
      Maintained only for legacy left-central boards; new boards should not use this property.
  capslock:
    type: int
    required: false
  numlock:
    type: int
    required: false
  scrolllock:
    type: int
    required: false
  layer-state:
    type: array
    required: false
  ble-state:
    type: array
    required: false
  usb-state:
    type: int
    required: false
  output-fallback:
    type: int
    required: false
  central-usb:
    type: array
    required: false
    description: >
      LED indices indicating that the dongle central is outputting USB
```
