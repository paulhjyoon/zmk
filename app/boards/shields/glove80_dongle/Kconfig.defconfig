## app/boards/shields/glove80_dongle/Kconfig.defconfig
```kconfig
if SHIELD_GLOVE80_DONGLE

# Name must be less than 16 characters long!
config ZMK_KEYBOARD_NAME
    default "Glove80"

config ZMK_SPLIT_ROLE_CENTRAL
    default y

endif

if SHIELD_GLOVE80_DONGLE || SHIELD_GLOVE80_LH || SHIELD_GLOVE80_RH

config ZMK_SPLIT
    default y

endif
```

## app/boards/shields/glove80_dongle/Kconfig.shield
```kconfig
config SHIELD_GLOVE80_DONGLE
	def_bool $(shields_list_contains,glove80_dongle_central)

config SHIELD_GLOVE80_LH
	def_bool $(shields_list_contains,glove80_dongle_left)

config SHIELD_GLOVE80_RH
	def_bool $(shields_list_contains,glove80_dongle_right)
```
