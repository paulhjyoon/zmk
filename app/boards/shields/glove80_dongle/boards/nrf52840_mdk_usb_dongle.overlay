/ {
	chosen {
		/delete-property/ zmk,backlight;
	};

	kscan0: kscan {
		compatible = "zmk,kscan-gpio-direct";
		label = "DONGLE_KSCAN";
		input-gpios = <&gpio0 18 (GPIO_ACTIVE_LOW | GPIO_PULL_UP)>;
		status = "okay";
	};
};

&{/buttons} {
	status = "disabled";
};